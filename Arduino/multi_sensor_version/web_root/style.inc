<style>
	.t {
		color:black;
		font-weight:bolder;
		background-color:white;	
		BORDER-BOTTOM:black 1px solid
	}
	.h {
		color:white;
		font-weight:bolder;
		background-color:#003366;	
	}
	.h1 {
		color:#004464;
		font-weight:bolder;
		background-color:#FFFFFF;	
	}
	.h2 {
		color:#004464;
		font-weight:bolder;
		background-color:#FFFFFF;	
	}
	.std{
		color:black;
		text-decoration:underline;
	}
	.s{color:black;text-decoration:none}		
	a {color:black;text-dec-oration:none}
	a:hover{color:gray;text-decoration:underline}
	BODY { font-family:Arial;font-size:12px } 
	TABLE{ font-family:Arial;font-size:12px } 
	.d{BORDER-BOTTOM:#c0c0c0 2px solid}
	.btn{
	   color:black;
	   background-color:#FFFFFF;
	   font-weight:bolder;
	   border-style:solid;
	   border-width:1px;
	}
	p { 
	color:#000000; 
		font-family:"ariel",sans-serif;
		font-size:11pt; 
		}
	h1 { 
		color:#003366; 
		font-family:"ariel",sans-serif; 
		font-size:30pt; 
		}
	h2 { 
		color:gray; 
		font-family:"ariel",sans-serif; 
		font-size:12pt; 
		}
</style>

